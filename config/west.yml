## config/west.yml
```yaml
manifest:
  remotes:
    - name: zmkfirmware
      url-base: https://github.com/zmkfirmware
    - name: caksoylar
      url-base: https://github.com/caksoylar
    - name: trmint195
      url-base: https://github.com/trmint195/
    - name: carrefinho
      url-base: https://github.com/carrefinho
    - name: prospector
      url-base: https://github.com/t-ogura
  projects:
    - name: zmk
      remote: zmkfirmware
      revision: main
      import: app/west.yml
    - name: zmk-rgbled-widget
      remote: caksoylar
      revision: main
    - name: prospector-zmk-module
      remote: prospector
      revision: v2.2.1
      path: modules/prospector-zmk-module
  self:
    path: config
```
